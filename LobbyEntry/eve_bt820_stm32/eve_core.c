/**
 * @file eve_core.c
 * @brief EVE core implementation
 * @author Bridgetek
 * @copyright MIT License (https://opensource.org/licenses/MIT)
 * @date 2026
 */
#include "eve.h"
#include "eve_bt820.h"

#define ENABLE_RESET_MCU_WHEN_COPROCESSOR_FAULTY 1

#define EXTRACT_CHIPID(romChipId) EVE_extendedChipId((((romChipId) >> 8) & 0xFF) | (((romChipId) & (0xFF)) << 8))

static inline void endFunc(EVE_HalContext *phost)
{
	if (phost->Status == EVE_STATUS_WRITING)
	{
		EVE_Hal_endTransfer(phost);
	}
}
uint16_t EVE_Cmd_rp(EVE_HalContext *phost)
{
	uint16_t rp;
	endFunc(phost);
	rp = EVE_Hal_rd16(phost, REG_CMD_READ) & EVE_CMD_FIFO_MASK;
	if (EVE_CMD_FAULT(rp))
		phost->CmdFault = true;
	return rp;
}
uint16_t EVE_Cmd_wp(EVE_HalContext *phost)
{
	endFunc(phost);
	return EVE_Hal_rd16(phost, REG_CMD_WRITE) & EVE_CMD_FIFO_MASK;
}
uint16_t EVE_Cmd_space(EVE_HalContext *phost)
{
	uint16_t space;
	uint16_t wp;
	uint16_t rp;
	endFunc(phost);
	space = EVE_Hal_rd16(phost, REG_CMDB_SPACE) & EVE_CMD_FIFO_MASK;
	if (EVE_CMD_FAULT(space))
		phost->CmdFault = true;
	phost->CmdSpace = space;
	return space;
}
static void startBufferTransfer(EVE_HalContext *phost)
{
	if (phost->Status != EVE_STATUS_WRITING)
	{
		EVE_Hal_startTransfer(phost, EVE_TRANSFER_WRITE, REG_CMDB_WRITE);
	}
}
static uint32_t wrString(EVE_HalContext *phost, const void *buffer, uint32_t *size, uint32_t transfered, uint32_t transfer)
{
	uint32_t t;
	eve_assert(transfered == 0);
	eve_assert(transfer == *size);
	eve_assert(transfer <= phost->CmdSpace);
	t = EVE_Hal_transferString(phost, (const char *)buffer, transfered, transfer, 0x3);
	if (t != transfer)
	{
		eve_assert(t <= phost->CmdSpace);
		transfer = t;
		*size = (transfered + transfer);
	}
	eve_assert((transfered + transfer) == *size);
	return transfer;
}
static uint32_t wrBuffer(EVE_HalContext *phost, const void *buffer, uint32_t size, bool progmem, bool string)
{
	uint32_t transfered = 0;
	do
	{
		uint32_t transfer = (size - transfered);
		uint32_t space = phost->CmdSpace;
		uint32_t req = min((string ? (transfer + 1) : transfer), (EVE_CMD_FIFO_SIZE >> 1));
		eve_assert(!string || (req == (transfer + 1)));
		if (space < req)
		{
			if (!EVE_Cmd_waitSpace(phost, req))
				return transfered;
			space = phost->CmdSpace;
		}
		if (transfer > space)
			transfer = space;
		eve_assert(transfer <= EVE_CMD_FIFO_SIZE - 4);
		if (transfer)
		{
			startBufferTransfer(phost);
			if (string)
			{
				transfer = wrString(phost, buffer, &size, transfered, transfer);
			}
			else if (progmem)
			{
				EVE_Hal_transferProgMem(phost, NULL, (const uint8_t *)(uintptr_t)(&((uint8_t *)buffer)[transfered]), transfer);
			}
			else
			{
				EVE_Hal_transferMem(phost, NULL, &((uint8_t *)buffer)[transfered], transfer);
			}
			if (!string && (transfer & 0x3))
			{
				uint32_t pad = 4 - (transfer & 0x3);
				uint8_t padding[4] = {0};
				eve_assert((transfered + transfer) == size);
				EVE_Hal_transferMem(phost, NULL, padding, pad);
				transfer += pad;
				eve_assert(!(transfer & 0x3));
			}
			transfered += transfer;
			if (!phost->CmdFunc)
			{
				EVE_Hal_endTransfer(phost);
			}
			eve_assert(phost->CmdSpace >= transfer);
			phost->CmdSpace -= (uint16_t)transfer;
		}
	} while (transfered < size);
	return transfered;
}
void EVE_Cmd_startFunc(EVE_HalContext *phost)
{
	eve_assert(!phost->CmdWaiting);
	eve_assert(phost->CmdBufferIndex == 0);
	phost->CmdFunc = true;
}
void EVE_Cmd_endFunc(EVE_HalContext *phost)
{
	eve_assert(!phost->CmdWaiting);
	eve_assert(phost->CmdBufferIndex == 0);
	endFunc(phost);
	phost->CmdFunc = false;
}
bool EVE_Cmd_wrMem(EVE_HalContext *phost, const uint8_t *buffer, uint32_t size)
{
	eve_assert(!phost->CmdWaiting);
	eve_assert(phost->CmdBufferIndex == 0);
	return wrBuffer(phost, buffer, size, false, false) == size;
}
bool EVE_Cmd_wrProgMem(EVE_HalContext *phost, const uint8_t *buffer, uint32_t size)
{
	eve_assert(!phost->CmdWaiting);
	eve_assert(phost->CmdBufferIndex == 0);
	return wrBuffer(phost, (void *)(uintptr_t)buffer, size, true, false) == size;
}
uint32_t EVE_Cmd_wrString(EVE_HalContext *phost, const char *str, uint32_t maxLength)
{
	uint32_t transfered;
	eve_assert(!phost->CmdWaiting);
	eve_assert(phost->CmdBufferIndex == 0);
	transfered = wrBuffer(phost, str, maxLength, false, true);
	return transfered;
}
bool EVE_Cmd_wr8(EVE_HalContext *phost, uint8_t value)
{
	eve_assert(!phost->CmdWaiting);
	eve_assert(phost->CmdBufferIndex < 4);
	if (phost->CmdBufferIndex < 4)
	{
		phost->CmdBuffer[phost->CmdBufferIndex++] = value;
	}
	if (phost->CmdBufferIndex == 4)
	{
		phost->CmdBufferIndex = 0;
		return EVE_Cmd_wrMem(phost, phost->CmdBuffer, 4);
	}
	return true;
}
bool EVE_Cmd_wr16(EVE_HalContext *phost, uint16_t value)
{
	eve_assert(!phost->CmdWaiting);
	eve_assert(phost->CmdBufferIndex < 3);
	if (phost->CmdBufferIndex < 3)
	{
		phost->CmdBuffer[phost->CmdBufferIndex++] = value & 0xFF;
		phost->CmdBuffer[phost->CmdBufferIndex++] = value >> 8;
	}
	if (phost->CmdBufferIndex == 4)
	{
		phost->CmdBufferIndex = 0;
		return EVE_Cmd_wrMem(phost, phost->CmdBuffer, 4);
	}
	return true;
}
bool EVE_Cmd_wr32(EVE_HalContext *phost, uint32_t value)
{
	eve_assert(!phost->CmdWaiting);
	eve_assert(phost->CmdBufferIndex == 0);
	if (phost->CmdSpace < 4 && !EVE_Cmd_waitSpace(phost, 4))
		return false;
	if (phost->Status != EVE_STATUS_WRITING)
	{
		EVE_Hal_startTransfer(phost, EVE_TRANSFER_WRITE, REG_CMDB_WRITE);
	}
	EVE_Hal_transfer32(phost, value);
	if (!phost->CmdFunc)
	{
		EVE_Hal_endTransfer(phost);
	}
	eve_assert(phost->CmdSpace >= 4);
	phost->CmdSpace -= 4;
	return true;
}
uint16_t EVE_Cmd_moveWp(EVE_HalContext *phost, uint16_t bytes)
{
	uint16_t wp;
	uint16_t prevWp;
	eve_assert(!phost->CmdWaiting);
	eve_assert(phost->CmdBufferIndex == 0);
	if (!EVE_Cmd_waitSpace(phost, bytes))
		return -1;
	prevWp = EVE_Cmd_wp(phost);
	wp = (prevWp + bytes) & EVE_CMD_FIFO_MASK;
	EVE_Hal_wr16(phost, REG_CMD_WRITE, wp);
	return prevWp;
}
void debugBackupRamG(EVE_HalContext *phost);
static bool checkWait(EVE_HalContext *phost, uint16_t rpOrSpace)
{
    if (EVE_CMD_FAULT(rpOrSpace))
    {
        char err[128];
        err[0] = '\0';
        phost->CmdWaiting = false;
        if (!phost->DebugMessageVisible)
        {
            eve_printf_debug("Coprocessor fault\n");
            debugBackupRamG(phost);
            EVE_Hal_rdMem(phost, (uint8_t *)err, RAM_ERR_REPORT, 128);
            eve_printf_debug("%s\n", err);
#if ENABLE_RESET_MCU_WHEN_COPROCESSOR_FAULTY
            eve_printf_debug("Resetting MCU due to coprocessor fault...\n");
            EVE_mcu_reset();
#endif
        }
        return false;
    }
    if (phost->Status == EVE_STATUS_ERROR || phost->Status == EVE_STATUS_CLOSED)
    {
        phost->CmdWaiting = false;
        eve_printf_debug("Host error\n");
        return false;
    }
    return true;
}
static bool handleWait(EVE_HalContext *phost, uint16_t rpOrSpace)
{
	if (!checkWait(phost, rpOrSpace))
		return false;
	EVE_Hal_idle(phost);
	if (phost->CbCmdWait && !phost->CbCmdWait(phost))
	{
		phost->CmdWaiting = false;
		eve_printf_debug("Wait for coprocessor aborted\n");
		return false;
	}
	return true;
}
bool EVE_Cmd_waitFlush(EVE_HalContext *phost)
{
	uint16_t rp;
	uint16_t wp;
	eve_assert(!phost->CmdWaiting);
	phost->CmdWaiting = true;
	while ((rp = EVE_Cmd_rp(phost)) != (wp = EVE_Cmd_wp(phost)))
	{
		const uint32_t rpCmd = EVE_Hal_rd32(phost, RAM_CMD + rp);
		if (!handleWait(phost, rp))
		{
			phost->CmdSpace = (rp - wp - 4) & EVE_CMD_FIFO_MASK;
			return false;
		}
	}
	phost->CmdSpace = EVE_CMD_FIFO_SIZE - 4;
	phost->CmdWaiting = false;
	return true;
}
uint32_t EVE_Cmd_waitSpace(EVE_HalContext *phost, uint32_t size)
{
	uint16_t space;
	if (size > (EVE_CMD_FIFO_SIZE - 4))
	{
		eve_printf_debug("Requested free space exceeds coprocessor FIFO\n");
		return 0;
	}
	eve_assert(!phost->CmdWaiting);
	phost->CmdWaiting = true;
	space = phost->CmdSpace;
	if (space < size || !size)
		space = EVE_Cmd_space(phost);
	if (!checkWait(phost, space))
		return 0;
	while (space < size)
	{
		space = EVE_Cmd_space(phost);
		if (!handleWait(phost, space))
			return 0;
	}
	phost->CmdWaiting = false;
	return space;
}
bool EVE_Cmd_waitLogo(EVE_HalContext *phost)
{
	uint16_t rp;
	uint16_t wp;
	eve_assert(!phost->CmdWaiting);
	phost->CmdWaiting = true;
	do
	{
		rp = EVE_Cmd_rp(phost);
		wp = EVE_Cmd_wp(phost);
		if (!handleWait(phost, rp))
			return false;
	} while ((wp != 0) || (rp != 0));
	phost->CmdWaiting = false;
	return true;
}
bool EVE_Cmd_waitRead32(EVE_HalContext *phost, uint32_t ptr, uint32_t value)
{
	uint16_t rp;
	uint16_t wp;
	eve_assert(!phost->CmdWaiting);
	phost->CmdWaiting = true;
	while ((rp = EVE_Cmd_rp(phost)) != (wp = EVE_Cmd_wp(phost)))
	{
		if (EVE_Hal_rd32(phost, ptr) == value)
		{
			phost->CmdWaiting = false;
			return true;
		}
		if (!handleWait(phost, rp))
		{
			phost->CmdSpace = (rp - wp - 4) & EVE_CMD_FIFO_MASK;
			return false;
		}
	}
	phost->CmdSpace = EVE_CMD_FIFO_SIZE - 4;
	phost->CmdWaiting = false;
	return EVE_Hal_rd32(phost, ptr) == value;
}
void EVE_Cmd_restore(EVE_HalContext *phost)
{
	EVE_Cmd_rp(phost);
	EVE_Cmd_wp(phost);
	EVE_Cmd_space(phost);
}

#include <string.h>
EVE_HalPlatform g_HalPlatform;
EVE_HalPlatform *EVE_Hal_initialize()
{
	EVE_Mcu_initialize();
	EVE_Millis_initialize();
	EVE_HalImpl_initialize();
	return &g_HalPlatform;
}
void EVE_Hal_release()
{
	eve_assert_ex(g_HalPlatform.OpenedDevices == 0, "HAL context still open\n");
	EVE_HalImpl_release();
	EVE_Millis_release();
	EVE_Mcu_release();
	memset(&g_HalPlatform, 0, sizeof(EVE_HalPlatform));
}
void EVE_Hal_defaults(EVE_HalParameters *parameters)
{
	EVE_Hal_defaultsEx(parameters, -1);
}
void EVE_Hal_defaultsEx(EVE_HalParameters *parameters, size_t deviceIdx)
{
	memset(parameters, 0, sizeof(EVE_HalParameters));
	eve_assert_do(EVE_HalImpl_defaults(parameters, deviceIdx));
}
bool EVE_Hal_open(EVE_HalContext *phost, const EVE_HalParameters *parameters)
{
	memset(phost, 0, sizeof(EVE_HalContext));
	phost->UserContext = parameters->UserContext;
	phost->CbCmdWait = parameters->CbCmdWait;
	phost->ReadTimeout = 256;
	return EVE_HalImpl_open(phost, parameters);
}
void EVE_Hal_close(EVE_HalContext *phost)
{
	if (phost->Status == EVE_STATUS_CLOSED)
	{
		eve_printf_debug("Attempt to close HAL context that is already closed\n");
		return;
	}

	EVE_Util_closeFile(phost);
	EVE_HalImpl_close(phost);
	memset(phost, 0, sizeof(EVE_HalContext));
}
void EVE_Hal_idle(EVE_HalContext *phost)
{
	EVE_HalImpl_idle(phost);
}
uint8_t EVE_Hal_rd8(EVE_HalContext *phost, uint32_t addr)
{
	uint32_t value;
	EVE_Hal_startTransfer(phost, EVE_TRANSFER_READ, addr);
	value = EVE_Hal_transfer32(phost, 0);
	EVE_Hal_endTransfer(phost);
	return (value & 0x000000FF);
}
uint16_t EVE_Hal_rd16(EVE_HalContext *phost, uint32_t addr)
{
	uint32_t value;
	EVE_Hal_startTransfer(phost, EVE_TRANSFER_READ, addr);
	value = EVE_Hal_transfer32(phost, 0);
	EVE_Hal_endTransfer(phost);
	return (value & 0x0000FFFF);
}
uint32_t EVE_Hal_rd32(EVE_HalContext *phost, uint32_t addr)
{
	uint32_t value;
	EVE_Hal_startTransfer(phost, EVE_TRANSFER_READ, addr);
	value = EVE_Hal_transfer32(phost, 0);
	EVE_Hal_endTransfer(phost);
	return value;
}
void EVE_Hal_rdMem(EVE_HalContext *phost, uint8_t *result, uint32_t addr, uint32_t size)
{
	EVE_Hal_startTransfer(phost, EVE_TRANSFER_READ, addr);
	EVE_Hal_transferMem(phost, result, NULL, size);
	EVE_Hal_endTransfer(phost);
}
void EVE_Hal_wr8(EVE_HalContext *phost, uint32_t addr, uint8_t v)
{
	EVE_Hal_startTransfer(phost, EVE_TRANSFER_WRITE, addr);
	EVE_Hal_transfer32(phost, (uint32_t)v);
	EVE_Hal_endTransfer(phost);
}
void EVE_Hal_wr16(EVE_HalContext *phost, uint32_t addr, uint16_t v)
{
	EVE_Hal_startTransfer(phost, EVE_TRANSFER_WRITE, addr);
	EVE_Hal_transfer32(phost, (uint32_t)v);
	EVE_Hal_endTransfer(phost);
}
void EVE_Hal_wr32(EVE_HalContext *phost, uint32_t addr, uint32_t v)
{
	EVE_Hal_startTransfer(phost, EVE_TRANSFER_WRITE, addr);
	EVE_Hal_transfer32(phost, v);
	EVE_Hal_endTransfer(phost);
}
void EVE_Hal_wrMem(EVE_HalContext *phost, uint32_t addr, const uint8_t *buffer, uint32_t size)
{
	EVE_Hal_startTransfer(phost, EVE_TRANSFER_WRITE, addr);
	EVE_Hal_transferMem(phost, NULL, buffer, size);
	EVE_Hal_endTransfer(phost);
}
void EVE_Hal_wrProgMem(EVE_HalContext *phost, uint32_t addr, const uint8_t *buffer, uint32_t size)
{
	EVE_Hal_startTransfer(phost, EVE_TRANSFER_WRITE, addr);
	EVE_Hal_transferProgMem(phost, NULL, buffer, size);
	EVE_Hal_endTransfer(phost);
}
void EVE_Hal_wrString(EVE_HalContext *phost, uint32_t addr, const char *str, uint32_t index, uint32_t size, uint32_t padMask)
{
	EVE_Hal_startTransfer(phost, EVE_TRANSFER_WRITE, addr);
	EVE_Hal_transferString(phost, str, index, size, padMask);
	EVE_Hal_endTransfer(phost);
}

void EVE_Host_powerModeSwitch(EVE_HalContext *phost, EVE_POWER_MODE_T pwrmode)
{
	switch (pwrmode)
	{
	case EVE_ACTIVE_M:
		EVE_Hal_hostCommand5(phost, EVE_82X_ACTIVE, 0, 0, 0);
		break;
	case EVE_STANDBY_M:
		EVE_Hal_hostCommand5(phost, EVE_82X_STANDBY, 0, 0, 0);
		break;
	case EVE_SLEEP_M:
		EVE_Hal_hostCommand5(phost, EVE_82X_SLEEP, 0, 0, 0);
		break;
	case EVE_POWERDOWN_M:
		EVE_Hal_hostCommand5(phost, EVE_82X_POWERDOWN, 0, 0, 0);
		break;
	}
}

void EVE_Host_resetActive(EVE_HalContext *phost)
{
	EVE_Hal_hostCommand5(phost, EVE_82X_RESET, (uint8_t)EVE_82X_RESET_ACTIVE, 0, 0);
}
void EVE_Host_resetRemoval(EVE_HalContext *phost)
{
	EVE_Hal_hostCommand5(phost, EVE_82X_RESET, (uint8_t)EVE_82X_RESET_REMOVAL, 0, 0);
}
void EVE_Host_setPllSp1(EVE_HalContext *phost, EVE_CMD_SYS_PLL_FREQ val)
{
	const uint8_t sysPllFreq = (val.pllCks << 7) | val.pllNs;
	EVE_Hal_hostCommand5(phost, EVE_82X_SETPLLSP1, sysPllFreq, 0, 0);
}
void EVE_Host_setClkDiv(EVE_HalContext *phost, EVE_CMD_SYS_CLK_DIV val)
{
	const uint8_t sysClkDiv = (val.sysPllCps << 4) | val.freq;
	EVE_Hal_hostCommand5(phost, EVE_82X_SETCLKDIV, sysClkDiv, 0, 0);
}
void EVE_Host_setBootCfg(EVE_HalContext *phost, EVE_CMD_BOOT_CFG val)
{
	const uint8_t cmdBootCfg = (val.ddr << 7) | (val.jt << 6) | (val.audio << 5) | (val.watchdog << 4) | val.source;
	EVE_Hal_hostCommand5(phost, EVE_82X_SETBOOTCFG, cmdBootCfg, 0, 0);
}
void EVE_Host_bootCfgEn(EVE_HalContext *phost, EVE_CMD_BOOT_CFG_EN val)
{
	const uint8_t cmdBootCfgEn = (val.boot << 7) | (val.ddrType << 6) | (val.gpReg << 5) | val.enable;
	EVE_Hal_hostCommand5(phost, EVE_82X_BOOTCFGEN, cmdBootCfgEn, 0, 0);
}
void EVE_Host_setDdrType(EVE_HalContext *phost, EVE_CMD_DDR_TYPE val)
{
	const uint8_t cmdDdrType = (val.speed << 5) | (val.type << 3) | val.size;
	EVE_Hal_hostCommand5(phost, EVE_82X_SETDDRTYPE, cmdDdrType, 0, 0);
}
void EVE_Host_setGpReg(EVE_HalContext *phost, EVE_CMD_GPREG val)
{
	const uint8_t cmdGpReg = val.mode;
	EVE_Hal_hostCommand5(phost, EVE_82X_SETGPREG, cmdGpReg, 0, 0);
}
void EVE_Hal_displayMessage(EVE_HalContext *phost, const char *str, uint16_t size)
{
	uint32_t round = ((size + 31U) & ~31U);
	uint32_t addr = RAM_G + RAM_G_SIZE - round;
	uint32_t dl = 0;
	EVE_Hal_wrMem(phost, addr, (uint8_t *)str, size);
	EVE_Hal_startTransfer(phost, EVE_TRANSFER_WRITE, addr + size);
	for (uint32_t i = size; i < round; ++i)
		EVE_Hal_transfer32(phost, 0);
	EVE_Hal_endTransfer(phost);
	EVE_Hal_wr32(phost, RAM_DL + ((dl++) << 2), CLEAR_COLOR_RGB(0x00, 0x20, 0x40));
	EVE_Hal_wr32(phost, RAM_DL + ((dl++) << 2), CLEAR(1, 1, 1));
	EVE_Hal_wr32(phost, RAM_DL + ((dl++) << 2), BITMAP_HANDLE(15));
	EVE_Hal_wr32(phost, RAM_DL + ((dl++) << 2), BITMAP_SOURCE(addr));
	EVE_Hal_wr32(phost, RAM_DL + ((dl++) << 2), BITMAP_SIZE_H(0, 0));
	EVE_Hal_wr32(phost, RAM_DL + ((dl++) << 2), BITMAP_SIZE(NEAREST, BORDER, BORDER, 256, (round >> 2)));
	EVE_Hal_wr32(phost, RAM_DL + ((dl++) << 2), BITMAP_LAYOUT_H(0, 0));
	EVE_Hal_wr32(phost, RAM_DL + ((dl++) << 2), BITMAP_LAYOUT(TEXT8X8, 32, (round >> 2)));
	EVE_Hal_wr32(phost, RAM_DL + ((dl++) << 2), BEGIN(BITMAPS));
	EVE_Hal_wr32(phost, RAM_DL + ((dl++) << 2), VERTEX2II(32, 32, 15, 0));
#if ENABLE_ERR_REPORT
	EVE_Hal_wr32(phost, RAM_DL + ((dl++) << 2), BITMAP_SOURCE(RAM_ERR_REPORT));
	EVE_Hal_wr32(phost, RAM_DL + ((dl++) << 2), VERTEX2II(32, 96, 15, 0));
#endif
	EVE_Hal_wr32(phost, RAM_DL + ((dl++) << 2), DISPLAY());
	EVE_Hal_wr8(phost, REG_DLSWAP, DLSWAP_FRAME);
}

uint32_t EVE_Compat_rdRegCTouchTouch4XY(EVE_HalContext *phost)
{
	return EVE_Hal_rd32(phost, REG_CTOUCH_TOUCH4_XY);
}
int32_t EVE_Compat_rdRegVolPB(EVE_HalContext *phost)
{
	return EVE_Hal_rd32(phost, REG_VOL_L_PB);
}
void EVE_Compat_wrRegVolPB(EVE_HalContext *phost, uint8_t vol)
{
	EVE_Hal_wr32(phost, REG_VOL_L_PB, vol);
	EVE_Hal_wr32(phost, REG_VOL_R_PB, vol);
}
bool EVE_MediaFifo_set(EVE_HalContext *phost, uint32_t address, uint32_t size)
{
	bool res = true;
	
	if (phost->MediaFifoAddress != address || phost->MediaFifoSize != size)
	{
		EVE_Cmd_startFunc(phost);
		EVE_Cmd_wr32(phost, CMD_MEDIAFIFO);
		EVE_Cmd_wr32(phost, address);
		EVE_Cmd_wr32(phost, size);
		EVE_Cmd_endFunc(phost);
		res = EVE_Cmd_waitFlush(phost);
	}
	
	if (res)
	{
		eve_assert(EVE_Hal_rd32(phost, REG_MEDIAFIFO_READ) < size);
		eve_assert(EVE_Hal_rd32(phost, REG_MEDIAFIFO_WRITE) < size);
		phost->MediaFifoAddress = address;
		phost->MediaFifoSize = size;
	}
	else
	{
		phost->MediaFifoAddress = 0;
		phost->MediaFifoSize = 0;
	}
	return res;
}
void EVE_MediaFifo_close(EVE_HalContext *phost)
{
	phost->MediaFifoAddress = 0;
	phost->MediaFifoSize = 0;
	EVE_Hal_wr32(phost, REG_MEDIAFIFO_WRITE, EVE_MediaFifo_rp(phost));
}
uint32_t EVE_MediaFifo_rp(EVE_HalContext *phost)
{
	return EVE_Hal_rd32(phost, REG_MEDIAFIFO_READ);
}
uint32_t EVE_MediaFifo_wp(EVE_HalContext *phost)
{
	return EVE_Hal_rd32(phost, REG_MEDIAFIFO_WRITE);
}
uint32_t EVE_MediaFifo_space(EVE_HalContext *phost)
{
	if (!phost->MediaFifoSize)
		return 0;
	int32_t rp = EVE_Hal_rd32(phost, REG_MEDIAFIFO_READ);
	int32_t wp = EVE_Hal_rd32(phost, REG_MEDIAFIFO_WRITE);
	return rp > wp
			   ? (rp - wp - 4)
			   : (rp + phost->MediaFifoSize - wp - 4);
}
bool EVE_MediaFifo_wrMem(EVE_HalContext *phost, const uint8_t *buffer, uint32_t size, uint32_t *transfered)
{
	if (!phost->MediaFifoSize)
	{
		eve_printf_debug("EVE Media FIFO has not been set, cannot write\n");
		return false;
	}
	if (size <= phost->MediaFifoSize - 4)
	{
		uint32_t wp;
		int32_t overflow;
		if (!EVE_MediaFifo_waitSpace(phost, size, transfered))
			return false;
		wp = EVE_Hal_rd32(phost, REG_MEDIAFIFO_WRITE);
		overflow = (int32_t)(wp + size) - (int32_t)(phost->MediaFifoSize);
		if (overflow > 0)
		{
			eve_assert(phost->MediaFifoAddress + wp + size - overflow <= RAM_G_SIZE);
			eve_assert(phost->MediaFifoAddress + overflow <= RAM_G_SIZE);
			EVE_Hal_wrMem(phost, phost->MediaFifoAddress + wp, buffer, size - overflow);
			EVE_Hal_wrMem(phost, phost->MediaFifoAddress, &buffer[size - overflow], overflow);
		}
		else
		{
			eve_assert(phost->MediaFifoAddress + wp + size <= RAM_G_SIZE);
			EVE_Hal_wrMem(phost, phost->MediaFifoAddress + wp, buffer, size);
		}
		wp += size;
		if (wp >= phost->MediaFifoSize)
			wp -= phost->MediaFifoSize;
		eve_assert(wp < phost->MediaFifoSize);
		EVE_Hal_wr32(phost, REG_MEDIAFIFO_WRITE, wp);
		if (transfered)
			*transfered = size;
		return true;
	}
	else
	{
		uint32_t halfSize = ((phost->MediaFifoSize >> 3) << 2) - 4;
		uint32_t remaining = size;
		uint32_t done = 0;
		uint32_t wp;
		wp = EVE_Hal_rd32(phost, REG_MEDIAFIFO_WRITE);
		while (remaining)
		{
			uint32_t transfer = min(halfSize, remaining);
			int32_t overflow;
			if (!EVE_MediaFifo_waitSpace(phost, transfer, transfered))
				return false;
			overflow = (int32_t)(wp + transfer) - (int32_t)(phost->MediaFifoSize);
			if (overflow > 0)
			{
				eve_assert(phost->MediaFifoAddress + wp + transfer - overflow <= RAM_G_SIZE);
				eve_assert(phost->MediaFifoAddress + overflow <= RAM_G_SIZE);
				EVE_Hal_wrMem(phost, phost->MediaFifoAddress + wp, &buffer[done], transfer - overflow);
				EVE_Hal_wrMem(phost, phost->MediaFifoAddress, &buffer[done + transfer - overflow], overflow);
			}
			else
			{
				eve_assert(phost->MediaFifoAddress + wp + transfer <= RAM_G_SIZE);
				EVE_Hal_wrMem(phost, phost->MediaFifoAddress + wp, &buffer[done], transfer);
			}
			wp += transfer;
			done += transfer;
			remaining -= transfer;
			if (wp >= phost->MediaFifoSize)
				wp -= phost->MediaFifoSize;
			eve_assert(wp < phost->MediaFifoSize);
			EVE_Hal_wr32(phost, REG_MEDIAFIFO_WRITE, wp);
			if (transfered)
			{
				*transfered = done;
				if (EVE_Cmd_rp(phost) == EVE_Cmd_wp(phost))
					return true;
			}
		}
		return true;
	}
}

bool EVE_MediaFifo_waitFlush(EVE_HalContext *phost, bool orCmdFlush)
{
	return EVE_MediaFifo_waitSpace(phost, phost->MediaFifoSize - 4, orCmdFlush);
}
uint32_t EVE_MediaFifo_waitSpace(EVE_HalContext *phost, uint32_t size, bool orCmdFlush)
{
	uint32_t space;
	if (!phost->MediaFifoSize)
	{
		eve_printf_debug("EVE Media FIFO has not been set, cannot wait for space\n");
		return 0;
	}
	if (size > (phost->MediaFifoSize - 4))
	{
		eve_printf_debug("Requested free space exceeds media FIFO\n");
		return 0;
	}
	eve_assert(!phost->CmdWaiting);
	phost->CmdWaiting = true;
	space = EVE_MediaFifo_space(phost);
	if (!checkWait(phost, space))
		return 0;
	while (space < size)
	{
		space = EVE_MediaFifo_space(phost);
		if (!handleWait(phost, (uint16_t)space))
			return 0;
		phost->CmdWaiting = false;
		uint32_t cmdSpace = EVE_Cmd_waitSpace(phost, 0);
		if (!cmdSpace)
			return 0;
		if (orCmdFlush && cmdSpace == (EVE_CMD_FIFO_SIZE - 4))
			return 0;
		phost->CmdWaiting = true;
	}
	phost->CmdWaiting = false;
	return space;
}
void EVE_CoDlImpl_resetCoState(EVE_HalContext *phost);
static const uint16_t s_DisplayResolutions[EVE_DISPLAY_NB][4] = {
	{480, 272, 60, 0},
	{320, 240, 56, 0},
	{480, 272, 60, 0},
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	{1280, 800, 59, 0},
};
static inline void uploadTouchFirmware(EVE_HalContext *phost)
{
}
static inline void uploadPlotPatch(EVE_HalContext *phost)
{
	const uint8_t plot_patch_data [] = {
		0x7c, 0xda, 0x00, 0x50, 0x00, 0x20, 0x08, 0x0c, 0x78, 0x9c, 0xed, 0x58, 0x7d, 0x74, 0x54, 0xc5,
		0x15, 0x9f, 0x7d, 0xb3, 0x9b, 0x64, 0x37, 0x21, 0xec, 0x93, 0x14, 0x83, 0x65, 0x63, 0xb4, 0x2e,
		0x0b, 0x2a, 0x12, 0x25, 0x10, 0x28, 0x54, 0x67, 0x37, 0xfb, 0x96, 0x6c, 0x38, 0xa1, 0x8a, 0x14,
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		0xa3, 0x65, 0xb4, 0x8c, 0x96, 0xd1, 0xf2, 0xff, 0x59, 0xfe, 0x0d, 0x69, 0x7c, 0xbc, 0x2d, 0x00,
};eve_assert_do(EVE_Cmd_wr32(phost, CMD_LOADPATCH));
	eve_assert_do(EVE_Cmd_wr32(phost, 0));
	EVE_Cmd_wrProgMem(phost, plot_patch_data, sizeof(plot_patch_data));
	eve_assert_do(EVE_Cmd_waitFlush(phost));
}
int eve_loadpatch(EVE_HalContext *phost)
{
	const uint8_t patchdata[] = 
    {
        0x7c, 0xda, 0x00, 0x50, 0x00, 0x20, 0x64, 0x0f, 0x78, 0x9c, 0xed, 0x58, 0x7d, 0x74, 0x54, 0xd5, 
        0xb5, 0xbf, 0x73, 0xcf, 0x4c, 0x26, 0x33, 0x99, 0x84, 0xb9, 0x82, 0x10, 0x35, 0x13, 0x83, 0x8f, 
        0x30, 0x55, 0x11, 0xf0, 0x35, 0x12, 0xbe, 0x9e, 0x9c, 0xc9, 0xcc, 0x1d, 0x32, 0x61, 0x85, 0x1a, 
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        0xff, 0x7f, 0x3f, 0x7f, 0x05, 0xf2, 0xd7, 0x86, 0x6a, 0x00, 0x00, 0x00, 
    };
	
	char actual[128];
	const char *expected = "patch_fssnapshot_lvds_touch;1.3;fssnap-1.1;lvds-1.0;touch-1.1;";
    int i;
	EVE_Cmd_wr32(phost, CMD_LOADPATCH);
	EVE_Cmd_wr32(phost, 0);
	if (!EVE_Cmd_wrMem(phost, patchdata, sizeof(patchdata)))
		eve_printf_debug("patch data load failed");
	EVE_Cmd_waitFlush(phost);
	actual[0] = '\0';
	EVE_Hal_rdMem(phost, (uint8_t *)actual, RAM_HIMEM, RAM_ERR_REPORT_MAX);
	eve_printf_debug("actual:%s, expected:%s\n", (char *)actual, expected);
	for (i = 0; i < 128; i++)
	{
		if (actual[i] != expected[i])
		{
			eve_printf_debug("patch data return err, act:0x%x", actual[i]);
			return -1;
		}
		if (expected[i] == '\0')
			break;
	}
	return 0;
}
void EVE_Util_clearScreen(EVE_HalContext *phost)
{
	static const uint8_t c_DlCodeBootup[3 * 4 + 16 * 3 * 4] = {
		0, 0, 0, 2, // GPU instruction CLEAR_COLOR_RGB
		7, 0, 0, 0x26, // GPU instruction CLEAR

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		0, 0, 0, 0, // GPU instruction DISPLAY
	};
	EVE_Hal_wrProgMem(phost, RAM_DL, c_DlCodeBootup, sizeof(c_DlCodeBootup));
	EVE_Hal_wr8(phost, REG_DLSWAP, DLSWAP_FRAME);
}
void EVE_Hal_getNormalizedTouchTransform(
	EVE_HalContext *phost,
	int32_t *outA, int32_t *outB, int32_t *outC,
	int32_t *outD, int32_t *outE, int32_t *outF)
{
	uint32_t rotate, hsize, vsize;
	bool swapXY, mirrorX, mirrorY;
	int32_t a, b, c, d, e, f;
	rotate = EVE_Hal_rd32(phost, REG_RE_ROTATE);
	hsize = EVE_Hal_rd32(phost, REG_RE_W);
	vsize = EVE_Hal_rd32(phost, REG_RE_H);
	swapXY = (rotate & 0x2) != 0;
	mirrorX = (((rotate & 0x1) != 0) ^ ((rotate & 0x4) != 0));
	mirrorY = (((rotate & 0x1) != 0) ^ ((rotate & 0x2) != 0));
	a = EVE_Hal_rd32(phost, REG_TOUCH_TRANSFORM_A);
	b = EVE_Hal_rd32(phost, REG_TOUCH_TRANSFORM_B);
	c = EVE_Hal_rd32(phost, REG_TOUCH_TRANSFORM_C);
	d = EVE_Hal_rd32(phost, REG_TOUCH_TRANSFORM_D);
	e = EVE_Hal_rd32(phost, REG_TOUCH_TRANSFORM_E);
	f = EVE_Hal_rd32(phost, REG_TOUCH_TRANSFORM_F);
	if (swapXY)
	{
		int32_t ta = a, tb = b, tc = c;
		a = d;
		b = e;
		c = f;
		d = ta;
		e = tb;
		f = tc;
	}
	if (mirrorY)
	{
		d = -d;
		e = -e;
		f = ((int32_t)(vsize - 1) << 16) - f;
	}
	if (mirrorX)
	{
		a = -a;
		b = -b;
		c = ((int32_t)(hsize - 1) << 16) - c;
	}
	*outA = a;
	*outB = b;
	*outC = c;
	*outD = d;
	*outE = e;
	*outF = f;
}
void EVE_Hal_setNormalizedTouchTransform(
	EVE_HalContext *phost,
	int32_t inA, int32_t inB, int32_t inC,
	int32_t inD, int32_t inE, int32_t inF)
{
	uint32_t rotate, hsize, vsize;
	bool swapXY, mirrorX, mirrorY;
	int32_t a, b, c, d, e, f;
	rotate = EVE_Hal_rd32(phost, REG_RE_ROTATE);
	hsize = EVE_Hal_rd32(phost, REG_RE_W);
	vsize = EVE_Hal_rd32(phost, REG_RE_H);
	swapXY = (rotate & 0x2) != 0;
	mirrorX = (((rotate & 0x1) != 0) ^ ((rotate & 0x4) != 0));
	mirrorY = (((rotate & 0x1) != 0) ^ ((rotate & 0x2) != 0));
	a = inA;
	b = inB;
	c = inC;
	d = inD;
	e = inE;
	f = inF;
	if (mirrorX)
	{
		a = -a;
		b = -b;
		c = ((int32_t)(hsize - 1) << 16) - c;
	}
	if (mirrorY)
	{
		d = -d;
		e = -e;
		f = ((int32_t)(vsize - 1) << 16) - f;
	}
	if (swapXY)
	{
		int32_t ta = a, tb = b, tc = c;
		a = d;
		b = e;
		c = f;
		d = ta;
		e = tb;
		f = tc;
	}
	EVE_Hal_wr32(phost, REG_TOUCH_TRANSFORM_A, a);
	EVE_Hal_wr32(phost, REG_TOUCH_TRANSFORM_B, b);
	EVE_Hal_wr32(phost, REG_TOUCH_TRANSFORM_C, c);
	EVE_Hal_wr32(phost, REG_TOUCH_TRANSFORM_D, d);
	EVE_Hal_wr32(phost, REG_TOUCH_TRANSFORM_E, e);
	EVE_Hal_wr32(phost, REG_TOUCH_TRANSFORM_F, f);
}
static inline uint32_t getFreqOrPllOut(EVE_HalContext *phost)
{
	uint32_t freq;
	uint32_t sysStat0 = EVE_Hal_rd32(phost, SYS_STAT_0);
	int pllMultiplier = (sysStat0 >> 8) & 0x7F;
	freq = EVE_OSC_FREQ * pllMultiplier;
	return freq;
}

bool EVE_Util_isValidBootStatus(uint32_t bootStatus)
{
	const uint8_t highLevel = bootStatus >> 24;
	if (!(highLevel >= 'A' && highLevel <= 'Z'))
		return false;
	const uint8_t secondByte = (bootStatus >> 16) & 0xFF;
	if (!((secondByte >= 'A' && secondByte <= 'Z') ||
		  (secondByte >= 'a' && secondByte <= 'z') ||
		  secondByte == '.'))
		return false;
	const uint8_t thirdByte = (bootStatus >> 8) & 0xFF;
	if (!((thirdByte >= '0' && thirdByte <= '9') ||
		  thirdByte == '.'))
		return false;
	const uint8_t lastByte = bootStatus & 0xFF;
	if (!((lastByte >= '0' && lastByte <= '9') ||
		  lastByte == '.'))
		return false;
	return true;
}
bool EVE_Util_bootup(EVE_HalContext *phost, EVE_BootupParameters *bootup)
{
	const uint32_t expectedChipId = EVE_BT820;
	uint8_t engineStatus;
	uint32_t chipId;
	uint8_t id;
	uint32_t freq;
	uint32_t sysPll;
	uint32_t freqByte;
	EVE_CMD_SYS_CLK_DIV sysClkDiv = {0};
	EVE_CMD_BOOT_CFG bootCfg = {0};
	EVE_CMD_BOOT_CFG_EN bootCfgEn = {0};
	EVE_CMD_DDR_TYPE ddrType = {0};
	EVE_CMD_GPREG gpReg = {0};
	do
	{
		int tries = 0;
		if (!EVE_Hal_powerCycle(phost, true))
		{
			return false;
		}
		bootCfgEn.boot = 1;
		bootCfgEn.ddrType = 1;
		bootCfgEn.gpReg = 0;
		bootCfgEn.enable = 1;
		EVE_Host_bootCfgEn(phost, bootCfgEn);
		bootCfg.ddr = 1;
		bootCfg.jt = 1;
		bootCfg.audio = 1;
		bootCfg.watchdog = 0;
		bootCfg.source = 0;
		EVE_Host_setBootCfg(phost, bootCfg);
		ddrType.speed = 0;
		ddrType.type = 1;
		ddrType.size = 0;
		EVE_Host_setDdrType(phost, ddrType);
		gpReg.mode = 0;
		EVE_Host_setGpReg(phost, gpReg);
		bootCfgEn.boot = 1;
		bootCfgEn.ddrType = 1;
		bootCfgEn.gpReg = 0;
		bootCfgEn.enable = 0;
		EVE_Host_bootCfgEn(phost, bootCfgEn);
		sysPll = 576000000UL;
		freqByte = (uint32_t)((sysPll / EVE_FREQUENCY_DEFAULT) - 1);
		sysClkDiv.sysPllCps = 1;
		sysClkDiv.freq = freqByte;
		EVE_Host_setClkDiv(phost, sysClkDiv);
		EVE_Hal_hostCommand5(phost, EVE_82X_ACTIVE, 0, 0, 0);
		EVE_sleep(300);
		chipId = EVE_Hal_rd32(phost, ROM_CHIPID);
		while (EXTRACT_CHIPID(chipId) < EVE_FT800 || EXTRACT_CHIPID(chipId) > EVE_BT820)
		{
			eve_printf_debug("EVE ROM_CHIPID after wake up %lx\n", (unsigned long)chipId);
			++tries;
			EVE_sleep(20);
			if (phost->CbCmdWait && !phost->CbCmdWait(phost))
			{
				return false;
			}
			const uint32_t bootStatus = EVE_Hal_rd32(phost, BOOT_STATUS);
			const bool validBootStatus = EVE_Util_isValidBootStatus(bootStatus);
			eve_printf_debug("EVE BOOT_STATUS after wake up %lx\n", (unsigned long)bootStatus);
			if (validBootStatus)
				EVE_sleep(300);
			chipId = EVE_Hal_rd32(phost, ROM_CHIPID);
		}
	} while (!chipId);
	phost->ReadTimeoutOccured = false;
	if (expectedChipId && EXTRACT_CHIPID(chipId) != expectedChipId)
		eve_printf_debug("Mismatching EVE chip id %lx, expect model %lx\n", (unsigned long)((chipId >> 8) & 0xFF) | ((chipId & 0xFF) << 8), (unsigned long)expectedChipId);
	eve_printf_debug("EVE chip id %lx %lx.%lx (EVE gen %i)\n", (unsigned long)EVE_shortChipId(EXTRACT_CHIPID(chipId)), (unsigned long)((chipId >> 16) & 0xFF), (unsigned long)((chipId >> 24) & 0xFF), EVE_gen(EXTRACT_CHIPID(chipId)));
	EVE_Hal_wr32(phost, REG_PLAYBACK_LENGTH, 0);
	while ((id = EVE_Hal_rd8(phost, REG_ID)) != 0x7C)
	{
		eve_printf_debug("EVE register ID after wake up %x\n", (unsigned int)id);
		EVE_sleep(20);
		if (phost->CbCmdWait && !phost->CbCmdWait(phost))
			return false;
	}
	eve_printf_debug("EVE register ID after wake up %x\n", (unsigned int)id);
	eve_assert(chipId == EVE_Hal_rd32(phost, ROM_CHIPID));
	while ((engineStatus = EVE_Hal_rd8(phost, REG_CPURESET)) != 0x00)
	{
		if (engineStatus & 0x01)
		{
			eve_printf_debug("Coprocessor engine is not ready\n");
		}
		if (engineStatus & 0x02)
		{
			eve_printf_debug("Touch engine is not ready\n");
		}
		if (engineStatus & 0x04)
		{
			eve_printf_debug("Audio engine is not ready\n");
		}
		EVE_sleep(20);
		if (phost->CbCmdWait && !phost->CbCmdWait(phost))
			return false;
	}
	eve_printf_debug("All engines are ready\n");
	if (bootup->SystemClock != EVE_SYSCLK_DEFAULT)
	{
		uint32_t clockMHz = bootup->SystemClock * 12;
		freq = clockMHz * 1000 * 1000;
		EVE_Hal_wr32(phost, REG_FREQUENCY, freq);
		EVE_Hal_flush(phost);
		eve_printf_debug("EVE clock frequency set to %d MHz\n", (unsigned int)clockMHz);
	}
	else
	{
		freq = EVE_Hal_rd32(phost, REG_FREQUENCY);
		eve_printf_debug("EVE default clock is %d MHz\n", (unsigned int)(freq / 1000000));
	}

	EVE_Hal_setSPI(phost, bootup->SpiChannels);

	const char *spiChannels = (phost->SpiChannels == EVE_SPI_QUAD_CHANNEL)
								  ? "Quad"
								  : ((phost->SpiChannels == EVE_SPI_DUAL_CHANNEL) ? "Dual" : "Single");
	const char *requested = (bootup->SpiChannels == EVE_SPI_QUAD_CHANNEL)
								? "Quad"
								: ((bootup->SpiChannels == EVE_SPI_DUAL_CHANNEL) ? "Dual" : "Single");
	if (bootup->SpiChannels == phost->SpiChannels)
		eve_printf_debug("%s channel SPI\n", spiChannels);
	else
		eve_printf_debug("%s channel SPI (%s unsupported)\n", spiChannels, requested);

	if (EVE_Hal_rd32(phost, REG_FREQUENCY) != freq)
	{
		eve_printf_debug("SPI channel configuration change failed\n");
		if (bootup->SpiChannels > EVE_SPI_SINGLE_CHANNEL)
		{
			bootup->SpiChannels = EVE_SPI_SINGLE_CHANNEL;
			eve_printf_debug("Retry with %s channel SPI\n", bootup->SpiChannels ? "Dual" : "Single");
			return EVE_Util_bootup(phost, bootup);
		}
		return false;
	}
	
	eve_printf_debug("Goodix configuration\n");
	EVE_Hal_wr8(phost, REG_CPURESET, 2);
	EVE_Hal_wr16(phost, REG_TOUCH_CONFIG, 0x05d0);
	EVE_Hal_wr8(phost, REG_CPURESET, 0);

	{
		uint32_t ddrType = EVE_Hal_rd32(phost, DDR_TYPE) & 0x7;
		switch (ddrType)
		{
		case 0:
			phost->RamGSize = 128 * 1024 * 1024;
			break;
		case 1:
			phost->RamGSize = 256 * 1024 * 1024;
			break;
		case 2:
			phost->RamGSize = 512 * 1024 * 1024;
			break;
		case 3:
			phost->RamGSize = 1024 * 1024 * 1024;
			break;
		case 4:
			phost->RamGSize = 64 * 1024 * 1024;
			break;
		case 5:
			phost->RamGSize = 32 * 1024 * 1024;
			break;
		default:
			eve_printf_debug("Unknown DDR_TYPE %lu\n", (unsigned long)ddrType);
			phost->RamGSize = RAM_G_SIZE_MAX;
			break;
		}
	}

	phost->RamGAvailable = phost->RamGSize - RAM_G_RESERVED;
	if (phost->ReadTimeoutOccured)
	{
		eve_printf_debug("Read timeout occured\n");
		return false;
	}
	eve_printf_debug("RamGSize: %x \n", phost->RamGSize);
	return true;
}
bool EVE_Util_config(EVE_HalContext *phost, EVE_ConfigParameters *config)
{
	bool reconfigure = phost->PCLK;
	if (reconfigure)
	{
		eve_printf_debug("Reconfiguring\n");
		EVE_Cmd_waitFlush(phost);
	}
	const bool swapXY = EVE_Hal_rd8(phost, REG_RE_ROTATE) & 0x2;
	uint16_t wp;
	uint16_t rp;
	eve_assert(config->Width < 2048);
	eve_assert(config->Height < 2048);
	EVE_Hal_wr32(phost, REG_DISP, 0);
	EVE_Hal_wr32(phost, REG_SO_EN, 0);
	phost->PCLK = 0;
	EVE_Hal_wr16(phost, REG_HCYCLE, config->HCycle);
	EVE_Hal_wr16(phost, REG_HOFFSET, config->HOffset);
	EVE_Hal_wr16(phost, REG_HSYNC0, config->HSync0);
	EVE_Hal_wr16(phost, REG_HSYNC1, config->HSync1);
	EVE_Hal_wr16(phost, REG_VCYCLE, config->VCycle);
	EVE_Hal_wr16(phost, REG_VOFFSET, config->VOffset);
	EVE_Hal_wr16(phost, REG_VSYNC0, config->VSync0);
	EVE_Hal_wr16(phost, REG_VSYNC1, config->VSync1);
	EVE_Hal_wr8(phost, REG_PCLK_POL, config->PCLKPol);
	EVE_Hal_wr16(phost, REG_HSIZE, config->Width);
	EVE_Hal_wr16(phost, REG_VSIZE, config->Height);
	if (swapXY)
	{
		phost->Width = config->Height;
		phost->Height = config->Width;
	}
	else
	{
		phost->Width = config->Width;
		phost->Height = config->Height;
	}
	if (config->SwapchainFormat != -1)
	{
		int32_t scanoutSrcStride;
		uint32_t endAddr = phost->RamGSize - RAM_G_RESERVED;
		int swapchainFormat = config->SwapchainFormat;
		switch (swapchainFormat)
		{
		case RGB6:
			scanoutSrcStride = ((config->Width * 9) + 3) >> 2;
			break;
		case YCBCR:
			scanoutSrcStride = config->Width;
			break;
		default:
			swapchainFormat = RGB8;
		case RGB8:
			scanoutSrcStride = config->Width * 3;
			break;
		}
		int32_t bufferSize = scanoutSrcStride * config->Height;
		int32_t lvdsrxFormat = LVDSRX_FORMAT;
		eve_printf_debug("Swapchain format: %i, stride: %i, buffer size: 2x %i bytes\n", swapchainFormat, scanoutSrcStride, bufferSize);
		uint32_t sc0_buffer0 = endAddr - bufferSize;
		uint32_t sc0_buffer1 = sc0_buffer0 - bufferSize;
		uint32_t sc2_buffer0 = 0, sc2_buffer1 = 0;
		if (lvdsrxFormat == RGB8)
		{
			sc2_buffer0 = sc0_buffer1 - bufferSize * 3;
			sc2_buffer1 = sc2_buffer0 - bufferSize * 3;
		}
		else
		{
			sc2_buffer0 = sc0_buffer1 - bufferSize * 2;
			sc2_buffer1 = sc2_buffer0 - bufferSize * 2;
		}
		uint32_t sc1_buffer0 = sc2_buffer1 - bufferSize;
		uint32_t sc1_buffer1 = sc1_buffer0 - bufferSize;
		phost->RamGAvailable = sc1_buffer1;
		EVE_Hal_wr32(phost, REG_I2S_CTL, 0);
		EVE_Hal_wr32(phost, REG_I2S_CFG, 0x400);
		EVE_Hal_wr32(phost, REG_I2S_EN, 1);
		EVE_Hal_wr32(phost, REG_I2S_FREQ, 0x3CF0);
		EVE_Hal_wr32(phost, REG_SC0_SIZE, 2);
		EVE_Hal_wr32(phost, REG_SC0_PTR0, sc0_buffer0);
		EVE_Hal_wr32(phost, REG_SC0_PTR1, sc0_buffer1);
		eve_printf_debug("REG_SC0_PTR0: %x \n", sc0_buffer0);
		eve_printf_debug("REG_SC0_PTR1: %x \n", sc0_buffer1);
		EVE_Hal_wr32(phost, REG_SC1_SIZE, 2);
		EVE_Hal_wr32(phost, REG_SC1_PTR0, sc1_buffer0);
		EVE_Hal_wr32(phost, REG_SC1_PTR1, sc1_buffer1);
		eve_printf_debug("REG_SC1_PTR0: %x \n", sc1_buffer0);
		eve_printf_debug("REG_SC1_PTR1: %x \n", sc1_buffer1);
		EVE_Hal_wr32(phost, REG_RE_DEST, SWAPCHAIN_0);
		EVE_Hal_wr32(phost, REG_RE_FORMAT, swapchainFormat);
		EVE_Hal_wr32(phost, REG_RE_W, phost->Width);
		EVE_Hal_wr32(phost, REG_RE_H, phost->Height);
		EVE_Hal_wr32(phost, REG_SC2_SIZE, 2);
		EVE_Hal_wr32(phost, REG_SC2_PTR0, sc2_buffer0);
		EVE_Hal_wr32(phost, REG_SC2_PTR1, sc2_buffer1);
		EVE_Hal_wr32(phost, REG_LVDSRX_SETUP, ((LVDS_MODE_JEIDA_18 << 3) | (VS_POL_HIGH << 2) | (LVDSRX_ONE_CHANNEL) << 1 | LVDSRX_ONE_PIXEL_PER_CLK));
		EVE_Hal_wr32(phost, REG_LVDSRX_CTRL, ((8 << 12) | (CHn_CLKSEL_FALLING << 11) | (CHn_FRANGE_10_30 << 9) | (CHn_PWDN_B_ON << 8) | (8 << 4) | (CHn_CLKSEL_FALLING << 3) | (CHn_FRANGE_10_30 << 1) | CHn_PWDN_B_ON));
		EVE_Hal_wr32(phost, REG_LVDSRX_CORE_ENABLE, 1);
		EVE_Hal_wr32(phost, REG_LVDSRX_CORE_CAPTURE, 1);
		EVE_Hal_wr32(phost, REG_LVDSRX_CORE_SETUP, ((LVDSRX_ONE_CHANNEL << 1) | (LVDSRX_ONE_PIXEL_PER_CLK & 0x1)));
		EVE_Hal_wr32(phost, REG_LVDSRX_CORE_DEST, SWAPCHAIN_2);
		EVE_Hal_wr32(phost, REG_LVDSRX_CORE_FORMAT, lvdsrxFormat);
		EVE_Hal_wr32(phost, REG_LVDSRX_CORE_DITHER, 0);
		phost->CoRenderTargetDst = SWAPCHAIN_0;
		phost->CoRenderTargetFmt = swapchainFormat;
		phost->CoRenderTargetW = phost->Width;
		phost->CoRenderTargetH = phost->Height;
		EVE_Hal_wr32(phost, REG_SO_SOURCE, SWAPCHAIN_0);
		EVE_Hal_wr32(phost, REG_SO_FORMAT, swapchainFormat);
	}
	EVE_Util_clearScreen(phost);
	wp = EVE_Cmd_wp(phost);
	rp = EVE_Cmd_rp(phost);
	EVE_Cmd_space(phost);
	phost->MediaFifoAddress = 0;
	phost->MediaFifoSize = 0;
	if (reconfigure ? EVE_CMD_FAULT(rp) : (wp || rp))
	{
		eve_printf_debug("Coprocessor fifo not empty\n");
		if (!EVE_Util_resetCoprocessor(phost))
			return false;
	}
	else
	{
		eve_printf_debug("Configure coprocessor defaults\n");
		EVE_Cmd_wr32(phost, CMD_DLSTART);
		EVE_Cmd_wr32(phost, CMD_COLDSTART);
		EVE_CoDlImpl_resetCoState(phost);
	}
	EVE_Hal_flush(phost);
	if (!EVE_Cmd_waitFlush(phost))
		return false;
	uint32_t lvdsPllCfg = EVE_Hal_rd32(phost, LVDSPLL_CFG);
	lvdsPllCfg &= ~0xFUL;
	lvdsPllCfg |= (config->PCLK - 1);
	uint32_t lvdsCtlClk = ((config->RefClkFreq / config->PCLK) / 2) * 7;
	uint32_t lvdsCks = lvdsCtlClk < 400000000 ? 1 : 2;
	lvdsPllCfg &= ~(0x3UL << 11);
	lvdsPllCfg |= (lvdsCks << 11);
	EVE_Hal_wr32(phost, LVDSPLL_CFG, lvdsPllCfg);
	uint32_t scanoutMode = (config->PixelsPerClock == 1 ? 0 : (config->PixelsPerClock == 2 ? 2 : 3));
	EVE_Hal_wr32(phost, REG_SO_MODE, scanoutMode);
	if (config->SwapchainFormat != -1)
	{
		EVE_Hal_wr32(phost, REG_SO_EN, 1);
		EVE_Hal_wr32(phost, REG_DISP, 1);
		EVE_Hal_wr32(phost, REG_PWM_DUTY, 128);
		phost->PCLK = 1;
		EVE_Hal_wr32(phost, REG_LVDS_EN, 0);
		EVE_Hal_wr32(phost, REG_LVDS_EN, 7);
		EVE_sleep(10);
	}

	eve_printf_debug("LVDS_EN: %x \n", EVE_Hal_rd32(phost, REG_LVDS_EN));
	eve_printf_debug("LVDSPLL_CFG: %x \n", EVE_Hal_rd32(phost, REG_LVDS_PLLCFG));
	eve_printf_debug("LVDS_CTRL_CH0: %x \n", EVE_Hal_rd32(phost, REG_LVDS_CTRL_CH0));
	eve_printf_debug("LVDS_CTRL_CH1: %x \n", EVE_Hal_rd32(phost, REG_LVDS_CTRL_CH1));
	eve_printf_debug("LVDS_STAT: %x \n", EVE_Hal_rd32(phost, REG_LVDS_STAT));
	eve_printf_debug("LVDS_ERR_STAT: %x \n", EVE_Hal_rd32(phost, REG_LVDS_ERR_STAT));
	eve_printf_debug("REG_SO_EN: %x \n", EVE_Hal_rd32(phost, REG_SO_EN));
	eve_printf_debug("REG_SO_MODE: %x \n", EVE_Hal_rd32(phost, REG_SO_MODE));
	phost->DDR_RamSize = 128 * 1024 * 1024;
	eve_loadpatch(phost);
	char msg[128];
	EVE_Hal_rdMem(phost, msg, RAM_HIMEM, 128);
	eve_printf_debug("Read Patch Data: %s \n", msg);
	eve_printf_debug("EVE configuration ready\n");
	uint32_t chip_id_otp;
	chip_id_otp = EVE_Hal_rd32(phost, 0x7F800448);
	return true;
}
void EVE_Util_shutdown(EVE_HalContext *phost)
{
	EVE_Hal_wr16(phost, REG_GPIO_DIR, 0xffff);
	EVE_Hal_wr16(phost, REG_GPIO, 0xffff);
	EVE_Hal_wr8(phost, REG_SO_EN, 0);
	EVE_Hal_flush(phost);
	EVE_Hal_powerCycle(phost, false);
}
void debugBackupRamG(EVE_HalContext *phost)
{
	if (!phost->DebugMessageVisible)
	{
		EVE_Hal_rdMem(phost, phost->DebugBackup, RAM_G + RAM_G_SIZE - sizeof(phost->DebugBackup), sizeof(phost->DebugBackup));
		phost->DebugMessageVisible = true;
	}
}
static void debugRestoreRamG(EVE_HalContext *phost)
{
	if (phost->DebugMessageVisible)
	{
		EVE_Hal_wrMem(phost, RAM_G + RAM_G_SIZE - sizeof(phost->DebugBackup), phost->DebugBackup, sizeof(phost->DebugBackup));
		phost->DebugMessageVisible = false;
	}
}
bool EVE_Util_resetCoprocessor(EVE_HalContext *phost)
{
	bool ready;
	uint16_t rd;
	uint16_t wr;
	(void)rd;
	(void)wr;
	eve_printf_debug("Reset coprocessor\n");
	EVE_Hal_wr8(phost, REG_CPURESET, 1);
	EVE_Hal_flush(phost);
	EVE_sleep(100);
	EVE_Hal_wr16(phost, REG_CMD_READ, 0);
	EVE_Hal_wr16(phost, REG_CMD_WRITE, 0);
	EVE_Hal_wr16(phost, REG_CMD_DL, 0);
	EVE_Hal_wr8(phost, REG_SO_EN, phost->PCLK);
	EVE_Hal_wr8(phost, REG_PLAYBACK_PLAY, 0);
	phost->CmdFault = false;
	EVE_Hal_wr8(phost, REG_CPURESET, 0);
	EVE_Hal_flush(phost);
	EVE_sleep(100);
	eve_assert((wr = EVE_Hal_rd16(phost, REG_CMD_WRITE)) == 0);
	eve_assert((rd = EVE_Hal_rd16(phost, REG_CMD_READ)) == 0);
	EVE_Cmd_waitFlush(phost);
	phost->MediaFifoAddress = 0;
	phost->MediaFifoSize = 0;
	EVE_Cmd_wr32(phost, CMD_DLSTART);
	EVE_Cmd_wr32(phost, CMD_COLDSTART);
	ready = EVE_Cmd_waitFlush(phost);
	if (phost->CbCoprocessorReset)
		phost->CbCoprocessorReset(phost, !ready);
	debugRestoreRamG(phost);
	EVE_CoDlImpl_resetCoState(phost);
	return ready;
}
bool EVE_Util_bootupConfig(EVE_HalContext *phost)
{
	EVE_BootupParameters bootup;
	EVE_ConfigParameters config;

	int32_t chipId = EVE_BT820;
	memset(&bootup, 0, sizeof(EVE_BootupParameters));

	bootup.SystemClock = EVE_SYSCLK_72M;
	bootup.SpiChannels = EVE_SPI_QUAD_CHANNEL;
	bootup.SpiDummyBytes = 2;

	if (!EVE_Util_bootup(phost, &bootup))
	{
		return false;
	}

	config.Width = 1920;
	config.Height = 1200;
	config.HCycle = 2080;
	config.HOffset = 50;
	config.HSync0 = 0;
	config.HSync1 = 30;
	config.VCycle = 1244;
	config.VOffset = 10;
	config.VSync0 = 0;
	config.VSync1 = 3;
	config.PCLK = 4;
	config.PixelsPerClock = 4;
	config.PCLKPol = 0;
	config.SwapchainFormat = YCBCR;

	if (!EVE_Util_config(phost, &config))
	{
		EVE_Util_shutdown(phost);
		return false;
	}
	return true;
}
void EVE_Util_forceFault(EVE_HalContext *phost, const char *err)
{
	if (!EVE_Cmd_waitSpace(phost, 0))
		return;
	EVE_Hal_wr8(phost, REG_CPURESET, 1);
	EVE_Hal_flush(phost);
	EVE_sleep(100);
	EVE_Hal_wr16(phost, REG_CMD_READ, 0xFFF);
	EVE_Hal_wr16(phost, REG_CMD_WRITE, 0xFFF);
	if (EVE_Cmd_rp(phost) & 0x3)
	{
		uint32_t errLen = (uint32_t)strlen(err);
		EVE_Hal_wrMem(phost, RAM_ERR_REPORT, (const uint8_t *)err, errLen);
		if (errLen < RAM_ERR_REPORT_MAX)
		{
			EVE_Hal_startTransfer(phost, EVE_TRANSFER_WRITE, RAM_ERR_REPORT + errLen);
			for (int i = (int)errLen; i < RAM_ERR_REPORT_MAX; ++i)
				EVE_Hal_transfer32(phost, 0);
			EVE_Hal_endTransfer(phost);
		}
	}
	EVE_Cmd_waitFlush(phost);
}

uint32_t EVE_Hal_romFontAddress(EVE_HalContext *phost, uint32_t romFont)
{
	if (1)
	{
		const uint32_t ramSize = phost->RamGSize;
		const uint32_t fontRoots = ramSize - 0x100;
		const uint32_t romFontAddr = EVE_Hal_rd32(phost, fontRoots + (romFont * 4));
		return romFontAddr;
	}
	{
		const uint32_t romFontTableAddr = EVE_Hal_rd32(phost, ROMFONT_TABLEADDRESS);
		const uint32_t romFontAddr = romFontTableAddr + (EVE_GPU_FONT_TABLE_SIZE * (romFont - 16));
		return romFontAddr;
	}
}

bool Ft_Gpu_CoCmd_FlashRead(EVE_HalContext *phost, uint32_t dest, uint32_t src, uint32_t num)
{
	EVE_CoCmd_flashRead(phost, dest, src, num);
	return EVE_Cmd_waitFlush(phost);
}

/* Inline Utility Functions */
EVE_BT820_T EVE_extendedChipId(int chipId)
{
	switch (chipId & 0xFFFF)
	{
	case EVE_FT800 & 0xFFFF:
	case EVE_FT801 & 0xFFFF:
		return (EVE_BT820_T)((chipId & 0xFFFF) | 0x10000);
	case EVE_FT810 & 0xFFFF:
	case EVE_FT811 & 0xFFFF:
	case EVE_FT812 & 0xFFFF:
	case EVE_FT813 & 0xFFFF:
	case EVE_BT880 & 0xFFFF:
	case EVE_BT881 & 0xFFFF:
	case EVE_BT882 & 0xFFFF:
	case EVE_BT883 & 0xFFFF:
		return (EVE_BT820_T)((chipId & 0xFFFF) | 0x20000);
	case EVE_BT815 & 0xFFFF:
	case EVE_BT816 & 0xFFFF:
		return (EVE_BT820_T)((chipId & 0xFFFF) | 0x30000);
	case EVE_BT817 & 0xFFFF:
	case EVE_BT818 & 0xFFFF:
		return (EVE_BT820_T)((chipId & 0xFFFF) | 0x40000);
	case EVE_BT820 & 0xFFFF:
		return (EVE_BT820_T)((chipId & 0xFFFF) | 0x50000);
	default:
		break;
	}
	return (EVE_BT820_T)(chipId & 0xFFFF);
}
int EVE_shortChipId(EVE_BT820_T chipId)
{
	return chipId & 0xFFFF;
}
int EVE_gen(EVE_BT820_T chipId)
{
	switch (chipId)
	{
	case EVE_FT800:
	case EVE_FT801:
		return EVE1;
	case EVE_FT810:
	case EVE_FT811:
	case EVE_FT812:
	case EVE_FT813:
	case EVE_BT880:
	case EVE_BT881:
	case EVE_BT882:
	case EVE_BT883:
		return EVE2;
	case EVE_BT815:
	case EVE_BT816:
		return EVE3;
	case EVE_BT817:
	case EVE_BT818:
		return EVE4;
	case EVE_BT820:
		return EVE5;
	default:
		break;
	}
	return 0;
}
